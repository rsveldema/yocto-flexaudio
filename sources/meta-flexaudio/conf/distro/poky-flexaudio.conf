## sources/meta-flexaudio/conf/distro/poky-flexaudio.conf
```bitbake
require conf/distro/poky.conf

DISTRO = "poky-flexaudio"
DISTRO_NAME = "Poky-flexaudio (Yocto Project Reference Distro)"
POKY_INIT_MANAGER = "systemd"
INIT_MANAGER ?= "${POKY_INIT_MANAGER}"

DISTRO_FEATURES += "rauc"

VIRTUAL-RUNTIME_syslog = ""
VIRTUAL-RUNTIME_base-utils-syslog = ""


INHERIT:remove = "uninative"
```

## sources/meta-flexaudio/conf/layer.conf
```bitbake
# We have a conf and classes directory, add to BBPATH
BBPATH .= ":${LAYERDIR}"

# We have recipes-* directories, add to BBFILES
BBFILES += "${LAYERDIR}/recipes-*/*/*.bb \
            ${LAYERDIR}/recipes-*/*/*.bbappend"

BBFILE_COLLECTIONS += "meta-flexaudio"
BBFILE_PATTERN_meta-flexaudio = "^${LAYERDIR}/"
BBFILE_PRIORITY_meta-flexaudio = "10"

LAYERDEPENDS_meta-flexaudio = "core"
LAYERSERIES_COMPAT_meta-flexaudio = "scarthgap styhead"
```

## sources/meta-flexaudio/wic/sdimage-raspberrypi-flexaudio.wks
```
# short-description: Create Raspberry Pi SD card image
# long-description: Creates a partitioned SD card image for use with
# Raspberry Pi. Boot files are located in the first vfat partition.

part /uboot --source bootimg-partition --ondisk mmcblk0 --fstype=vfat --label boot --active --align 4096 --size 100
part / --source rootfs --ondisk mmcblk0 --fstype=ext4 --label system0 --align 4096 --size 1000
part / --source rootfs --ondisk mmcblk0 --fstype=ext4 --label system1 --align 4096 --size 1000
part /data --source rootfs --ondisk mmcblk0 --fstype=ext4 --label data --align 4096 --size 1000
```
